## software/firmware/main/Kconfig.projbuild
```kconfig
menu "Experimental Esper fork"
config WIFI_ENABLE
    bool
    default y
config WIFI_SSID
    string "Wi-Fi SSID (private; do not commit sdkconfig)"
    default ""
config WIFI_PASSWORD
    string "Wi-Fi password (private; do not commit sdkconfig)"
    default ""
config ESPER_QUERY_LOG_ENABLED
    bool "Enable read-only LAN query log (100 entries; browsing metadata)"
    default n
endmenu
```

## software/firmware/sdkconfig.defaults
```kconfig
CONFIG_IDF_TARGET="esp32"
CONFIG_WIFI_ENABLE=y
CONFIG_WIFI_SSID=""
CONFIG_WIFI_PASSWORD=""
# CONFIG_ESPER_QUERY_LOG_ENABLED is not set
CONFIG_COMPILER_CXX_EXCEPTIONS=y
CONFIG_COMPILER_CXX_EXCEPTIONS_EMG_POOL_SIZE=1024
CONFIG_ESPTOOLPY_FLASHSIZE_4MB=y
CONFIG_ESPTOOLPY_FLASHSIZE="4MB"
CONFIG_PARTITION_TABLE_CUSTOM=y
CONFIG_PARTITION_TABLE_CUSTOM_FILENAME="partitions_table.csv"
CONFIG_PARTITION_TABLE_FILENAME="partitions_table.csv"
CONFIG_ESP32_DEFAULT_CPU_FREQ_240=y
CONFIG_ESP32_DEFAULT_CPU_FREQ_MHZ=240
CONFIG_ESP_NETIF_TCPIP_ADAPTER_COMPATIBLE_LAYER=n
CONFIG_HTTPD_MAX_REQ_HDR_LEN=1024
CONFIG_HTTPD_MAX_URI_LEN=512
CONFIG_LITTLEFS_SPIFFS_COMPAT=y
# CONFIG_FREERTOS_USE_TRACE_FACILITY is not set
```
